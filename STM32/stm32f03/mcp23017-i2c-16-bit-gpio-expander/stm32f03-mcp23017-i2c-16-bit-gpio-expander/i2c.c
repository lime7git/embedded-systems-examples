#include "i2c.h"

void I2C_INIT(void)
{
	RCC->APB1ENR |= RCC_APB1ENR_PWREN;

	RCC->AHBENR |= RCC_AHBENR_GPIOBEN;
	RCC->APB1ENR |= RCC_APB1ENR_I2C2EN;
	
	GPIOB->MODER &= ~GPIO_MODER_MODER10 & ~GPIO_MODER_MODER11;
	GPIOB->MODER |= GPIO_MODER_MODER10_1 | GPIO_MODER_MODER11_1;
	
	GPIOB->AFR[1] |= 0x00001100;
	
	I2C2->TIMINGR = 0x0000020B;
	I2C2->CR1 = I2C_CR1_PE;
}


void MCP23017_SET_PORTB_OUTPUTS(void)
{
	I2C2->CR2 = (2 << I2C_CR2_NBYTES_Pos) | I2C_CR2_AUTOEND | 
							(MCP23017_ADDRESS << I2C_CR2_SADD_Pos) | I2C_CR2_START;
	
	while((I2C2->ISR & I2C_ISR_TXIS) == RESET) {}
	I2C2->TXDR = MCP23017_IODIR_ADDRESS;
	
	while((I2C2->ISR & I2C_ISR_TXIS) == RESET) {}
	I2C2->TXDR = 0x00;	
}

void MCP23017_SET_PORTB_PIN_LOW_AND_OTHER_HIGH(uint8_t PIN_NUMBER)
{
	I2C2->CR2 = (2 << I2C_CR2_NBYTES_Pos) | I2C_CR2_AUTOEND | 
							(MCP23017_ADDRESS << I2C_CR2_SADD_Pos) | I2C_CR2_START;
	
	while((I2C2->ISR & I2C_ISR_TXIS) == RESET) {}
	I2C2->TXDR = MCP23017_PORTB_GPIO_ADDRESS;
		
	while((I2C2->ISR & I2C_ISR_TXIS) == RESET) {}
	I2C2->TXDR = 0xFF & ~(0x1 << PIN_NUMBER);
}

void MCP23017_SEND_PORTB_REGISTER(uint8_t REG)
{
	I2C2->CR2 = (2 << I2C_CR2_NBYTES_Pos) | I2C_CR2_AUTOEND | 
							(MCP23017_ADDRESS << I2C_CR2_SADD_Pos) | I2C_CR2_START;
	
	while((I2C2->ISR & I2C_ISR_TXIS) == RESET) {}
	I2C2->TXDR = MCP23017_PORTB_GPIO_ADDRESS;
	
	while((I2C2->ISR & I2C_ISR_TXIS) == RESET) {}
	I2C2->TXDR = (uint8_t)REG;
}
